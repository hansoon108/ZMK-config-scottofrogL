## boards/shields/Kconfig.defconfig
```kconfig
if SHIELD_SCOTTOFROGL

config ZMK_KEYBOARD_NAME
    default "ScottoFrogL"

endif
```

## boards/shields/Kconfig.shield
```kconfig
config SHIELD_SCOTTOFROGL
    def_bool $(shields_list_contains,scottofrogL)
    
```
